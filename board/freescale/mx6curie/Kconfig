## board/freescale/mx6curie/Kconfig
```kconfig
if TARGET_MX6CURIE

config SYS_BOARD
	default "mx6curie"

config SYS_VENDOR
	default "freescale"

config SYS_SOC
	default "mx6"

config SYS_CONFIG_NAME
	default "mx6curie"

endif
```

## configs/mx6qcurie_defconfig
```kconfig
CONFIG_SYS_EXTRA_OPTIONS="IMX_CONFIG=board/freescale/mx6curie/mx6q_4x_h5tq2g63.cfg,MX6Q,DEFAULT_FDT_FILE=\"imx6q-curie.dtb\",DDR_MB=1024"
CONFIG_ARM=y
CONFIG_TARGET_MX6CURIE=y
CONFIG_DM=y
CONFIG_DM_THERMAL=y
```
